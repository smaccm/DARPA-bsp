## apps/can-test/Kconfig
```kconfig
#
# Copyright 2016, Data61
# Commonwealth Scientific and Industrial Research Organisation (CSIRO)
# ABN 41 687 119 230.
# This software may be distributed and modified according to the terms of
# the BSD 2-Clause license. Note that NO WARRANTY is provided.
# See "LICENSE_BSD2.txt" for details.
# @TAG(D61_BSD)
#

config APP_CANTEST
    bool "DARPA CAmkES CAN test application"
    default n
    help
        A simple application to test can functionality for DARPA SMACCM phase 3 on TK1.
```

## apps/timer_tk1/Kconfig
```kconfig
#
# Copyright 2014, NICTA
#
# This software may be distributed and modified according to the terms of
# the GNU General Public License version 2. Note that NO WARRANTY is provided.
# See "LICENSE_GPLv2.txt" for details.
#
# @TAG(NICTA_GPL)
#

menuconfig APP_TIMER_TK1
    bool "TK1 Timer test application"
    default n
    help 
        Application to test the TimeServer component on TK1.
```

## apps/uart-test-client/Kconfig
```kconfig
#
# Copyright 2016, Data61
# Commonwealth Scientific and Industrial Research Organisation (CSIRO)
# ABN 41 687 119 230.
# This software may be distributed and modified according to the terms of
# the BSD 2-Clause license. Note that NO WARRANTY is provided.
# See "LICENSE_BSD2.txt" for details.
# @TAG(D61_BSD)
#

config APP_UARTTEST_CLIENT
    bool "DARPA CAmkES UART client test application"
    default n
    help
        A simple application to test UART functionality for DARPA SMACCM phase 3 on TK1.
        Acts as the client component in a client-server test between two TK1s running
        CAmkES/seL4.
```

## apps/vm/Kconfig
```kconfig
#
# Copyright 2017, Data61
# Commonwealth Scientific and Industrial Research Organisation (CSIRO)
# ABN 41 687 119 230.
# This software may be distributed and modified according to the terms of
# the BSD 2-Clause license. Note that NO WARRANTY is provided.
# See "LICENSE_BSD2.txt" for details.
# @TAG(D61_BSD)
#

config APP_CAMKES_VM
    bool "CAmkES VM"
    depends on LIB_SEL4 && LIB_MUSL_C && LIB_SEL4_VKA && LIB_SEL4_ALLOCMAN && LIB_SEL4_PLAT_SUPPORT && \
            LIB_PLATSUPPORT && LIB_SEL4_VSPACE && LIB_ELF && LIB_SEL4_UTILS && LIB_SEL4_SIMPLE && \
            LIB_UTILS && LIB_SEL4_SIMPLE_DEFAULT && LIB_CPIO && LIB_SEL4_ARM_VMM && LIB_SEL4_SYNC && LIB_SEL4_DEBUG && \
            LIB_SEL4_DMA
    default y

source "projects/vm/components/VM/Kconfig"
```
